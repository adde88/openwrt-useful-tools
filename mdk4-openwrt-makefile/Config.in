## mdk4-openwrt-makefile/Config.in
```kconfig
menu "Configuration"
	depends on PACKAGE_mdk4

config MDK4_libnl
	bool "Use libnl (Chaos Calmer)"
	depends on PACKAGE_mdk4
	default n

config MDK4_libnl-genl
	bool "Use latest libnl (LEDE)"
	depends on PACKAGE_mdk4
	default y
```
